## app/boards/mechwild/s40nc/Kconfig.defconfig
```kconfig
# Copyright (c) 2021 The ZMK Contributors
# SPDX-License-Identifier: MIT

if BOARD_S40NC

config ZMK_KEYBOARD_NAME
    default "S40NC"

endif # BOARD_S40NC
```

## app/boards/nicekeyboards/nice60/Kconfig.defconfig
```kconfig
# Copyright (c) 2021 Nick Winans
# SPDX-License-Identifier: MIT

if BOARD_NICE60

config ZMK_KEYBOARD_NAME
    default "nice!60"

endif # BOARD_NICE60
```

## app/boards/nordic/nrf52840dongle/nrf52840dongle_nrf52840_zmk_defconfig
```kconfig
# Copyright (c) 2026 The ZMK Contributors
# SPDX-License-Identifier: MIT

# Enable MPU
CONFIG_ARM_MPU=y

# Enable hardware stack protection
CONFIG_HW_STACK_PROTECTION=y

# enable GPIO
CONFIG_GPIO=y

# Disable USB remote wakeup
CONFIG_ZMK_USB_REMOTE_WAKEUP=n

# HID Transports
CONFIG_ZMK_BLE=y
CONFIG_ZMK_USB=y

# Settings options
CONFIG_MPU_ALLOW_FLASH_WRITE=y
CONFIG_NVS=y
CONFIG_SETTINGS_NVS=y
CONFIG_FLASH=y
CONFIG_FLASH_PAGE_LAYOUT=y
CONFIG_FLASH_MAP=y
```

## app/boards/polarityworks/bt75/Kconfig.defconfig
```kconfig
# Copyright (c) 2022 The ZMK Contributors
# SPDX-License-Identifier: MIT

config ZMK_KEYBOARD_NAME
    default "BT75" if BOARD_BT75

if BOARD_BT75

endif # BOARD_BT75
```

## app/module/boards/joric/nrfmicro/Kconfig.defconfig
```kconfig
# Electronut Labs Papyr board configuration

# Copyright (c) 2020 The ZMK Contributors
# SPDX-License-Identifier: MIT

if BOARD_NRFMICRO_NRF52840 || BOARD_NRFMICRO_NRF52840_FLIPPED || BOARD_NRFMICRO_NRF52833

config BOARD
    default "nrfmicro"

if BOARD_REVISION = "1.3.0"

config BOARD_NRFMICRO_CHARGER
    default y

endif # BOARD_REVISION = "1.3.0"


endif # BOARD_NRFMICRO_NRF52840 || BOARD_NRFMICRO_NRF52840_FLIPPED || BOARD_NRFMICRO_NRF52833
```

## app/module/boards/keycapsss/puchi_ble/Kconfig.defconfig
```kconfig
# Copyright (c) 2026 The ZMK Contributors
# SPDX-License-Identifier: MIT

if BOARD_PUCHI_BLE

config BOARD
    default "puchi_ble"

endif # BOARD_PUCHI_BLE
```

## app/module/boards/zhiayang/mikoto/Kconfig.defconfig
```kconfig
# Electronut Labs Papyr board configuration

# Copyright (c) 2020 The ZMK Contributors
# SPDX-License-Identifier: MIT

if BOARD_MIKOTO

choice BOARD_MIKOTO_CHARGER_CURRENT
    default BOARD_MIKOTO_CHARGER_CURRENT_100MA
endchoice

endif # BOARD_MIKOTO
```

## app/module/drivers/sensor/Kconfig
```kconfig
# Copyright (c) 2020 The ZMK Contributors
# SPDX-License-Identifier: MIT

if SENSOR

rsource "battery/Kconfig"
rsource "ec11/Kconfig"
rsource "kailh-enc/Kconfig"
rsource "max17048/Kconfig"

rsource "encoder_mock/Kconfig"
rsource "mpr121/Kconfig"

endif # SENSOR
```

## app/module/drivers/sensor/kailh-enc/Kconfig
```kconfig
# Copyright (c) 2020 The ZMK Contributors
# SPDX-License-Identifier: MIT

menuconfig KAILH_ENC
    bool "Kailh ENC Incremental Encoder Sensor"
    default y
    depends on DT_HAS_KAILH_ENC_ENABLED
    depends on GPIO
    help
      Enable driver for Kailh ENC incremental encoder sensors.

if KAILH_ENC

choice KAILH_ENC_TRIGGER_MODE
    prompt "Trigger mode"
    default KAILH_ENC_TRIGGER_NONE
    help
      Specify the type of triggering to be used by the driver.

config KAILH_ENC_TRIGGER_NONE
    bool "No trigger"

config KAILH_ENC_TRIGGER_GLOBAL_THREAD
    bool "Use global thread"
    depends on GPIO
    select KAILH_ENC_TRIGGER

config KAILH_ENC_TRIGGER_OWN_THREAD
    bool "Use own thread"
    depends on GPIO
    select KAILH_ENC_TRIGGER

endchoice

config KAILH_ENC_TRIGGER
    bool

config KAILH_ENC_THREAD_PRIORITY
    int "Thread priority"
    depends on KAILH_ENC_TRIGGER_OWN_THREAD
    default 10
    help
      Priority of thread used by the driver to handle interrupts.

config KAILH_ENC_THREAD_STACK_SIZE
    int "Thread stack size"
    depends on KAILH_ENC_TRIGGER_OWN_THREAD
    default 1024
    help
      Stack size of thread used by the driver to handle interrupts.

endif # KAILH_ENC
```

## app/module/drivers/sensor/mpr121/Kconfig
```kconfig
# SPDX-License-Identifier: MIT

menuconfig MPR121
    bool "NXP MPR121 Capacitive Touchpad"
    default n
    depends on I2C
    depends on GPIO
    depends on INPUT
    help
      Enable driver for NXP MPR121 capacitive touchpad sensor.
      Provides touch coordinate tracking and swipe gesture detection.

if MPR121

choice MPR121_TRIGGER_MODE
    prompt "Trigger mode"
    default MPR121_TRIGGER_GLOBAL_THREAD

config MPR121_TRIGGER_NONE
    bool "No trigger (polling)"

config MPR121_TRIGGER_GLOBAL_THREAD
    bool "Use global thread"
    depends on GPIO
    select MPR121_TRIGGER

config MPR121_TRIGGER_OWN_THREAD
    bool "Use own thread"
    depends on GPIO
    select MPR121_TRIGGER

endchoice

config MPR121_TRIGGER
    bool

endif # MPR121
```

## app/module/dts/bindings/sensor/nxp,mpr121.yaml
```yaml
# SPDX-License-Identifier: MIT

description: |
  NXP MPR121 capacitive touchpad sensor driver.
  Provides touch coordinate tracking and swipe gesture detection
  using 12 electrode probes mapped to a grid.

compatible: "nxp,mpr121"

include: [i2c-device.yaml]

properties:
  interrupt-gpios:
    type: phandle-array
    required: true
    description: GPIO pin connected to the MPR121 RDY/INT pin for touch detection interrupt.

  touch-threshold:
    type: int
    required: false
    default: 4
    description: Touch detection threshold (1-255). Higher values require stronger touch signal.

  release-threshold:
    type: int
    required: false
    default: 2
    description: Release detection threshold (1-255). Must be lower than touch-threshold.

  movement-scale:
    type: int
    required: false
    default: 100
    description: Mouse movement scaling factor (percentage). 100 = 1:1 grid to movement ratio.

  gesture-min-displacement:
    type: int
    required: false
    default: 200
    description: Minimum swipe displacement x100 in grid units. Default 200 = 2.0 grid cells.

  gesture-min-velocity:
    type: int
    required: false
    default: 5000
    description: Minimum swipe velocity x100 in grid units per second. Default 5000 = 50 cells/sec.

  gesture-max-duration-ms:
    type: int
    required: false
    default: 500
    description: Maximum swipe duration in milliseconds. Longer touches are not considered swipes.

  poll-interval-ms:
    type: int
    required: false
    default: 10
    description: Polling interval in milliseconds while touch is active.

  report-interval-ms:
    type: int
    required: false
    default: 15
    description: >
      Interval in milliseconds at which accumulated mouse movement is flushed to a
      single report. Independent of poll-interval-ms. Tune to the BLE connection
      interval to batch movement and avoid over-producing reports over BLE.

  tap-max-duration-ms:
    type: int
    required: false
    default: 300
    description: Maximum duration in milliseconds for a tap gesture.

  tap-max-displacement:
    type: int
    required: false
    default: 1
    description: Maximum displacement x100 for a tap (e.g., 5 = 0.05 grid units).
```
