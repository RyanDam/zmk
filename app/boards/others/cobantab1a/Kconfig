## app/boards/others/cobantab1a/Kconfig
```kconfig
# Coban Tab 1a board configuration

# Copyright (c) 2026 The ZMK Contributors
# SPDX-License-Identifier: MIT

config HEAP_MEM_POOL_ADD_SIZE_BOARD
    int
    default 4096
```

## app/boards/others/cobantab1a/Kconfig.cobantab1a
```kconfig
# Copyright (c) 2026 The ZMK Contributors
# SPDX-License-Identifier: MIT

config BOARD_COBANTAB1A
    select SOC_ESP32S3_WROOM_N16R8
    select SOC_ESP32S3_PROCPU if BOARD_COBANTAB1A_ESP32S3_PROCPU
    select ZMK_BOARD_COMPAT
```

## app/boards/others/cobantab1a/board.yml
```yaml
# Copyright (c) 2026 The ZMK Contributors
# SPDX-License-Identifier: MIT

board:
  name: cobantab1a
  full_name: Coban Tab 1a (ESP32-S3 3.5" AXS15231B display module)
  vendor: others
  socs:
    - name: esp32s3
      variants:
        - name: zmk
          cpucluster: procpu
```

## app/boards/others/esp32c3_supermini/board.yml
```yaml
board:
  extend: esp32c3_supermini
  variants:
    - name: zmk
      qualifier: esp32c3
```

## app/boards/others/esp32s3_supermini/Kconfig
```kconfig
# ESP32-S3 SuperMini board configuration

# Copyright (c) 2026 The ZMK Contributors
# SPDX-License-Identifier: MIT

config HEAP_MEM_POOL_ADD_SIZE_BOARD
    int
    default 4096
```

## app/boards/others/esp32s3_supermini/Kconfig.esp32s3_supermini
```kconfig
# Copyright (c) 2026 The ZMK Contributors
# SPDX-License-Identifier: MIT

config BOARD_ESP32S3_SUPERMINI
    select SOC_ESP32S3
    select SOC_ESP32S3_PROCPU if BOARD_ESP32S3_SUPERMINI_ESP32S3_PROCPU
    select ZMK_BOARD_COMPAT
```

## app/boards/others/esp32s3_supermini/Kconfig.sysbuild
```kconfig
# Copyright (c) 2026 The ZMK Contributors
# SPDX-License-Identifier: MIT

choice BOOTLOADER
    default BOOTLOADER_MCUBOOT
endchoice

choice BOOT_SIGNATURE_TYPE
    default BOOT_SIGNATURE_TYPE_NONE
endchoice
```

## app/boards/others/esp32s3_supermini/board.yml
```yaml
# Copyright (c) 2026 The ZMK Contributors
# SPDX-License-Identifier: MIT

board:
  name: esp32s3_supermini
  full_name: ESP32-S3 SuperMini
  vendor: others
  socs:
    - name: esp32s3
      variants:
        - name: zmk
          cpucluster: procpu
```

## app/boards/shields/esp32c3_matrix_fixture/Kconfig.shield
```kconfig
# Copyright (c) 2026 The ZMK Contributors
# SPDX-License-Identifier: MIT

config SHIELD_ESP32C3_MATRIX_FIXTURE
    def_bool $(shields_list_contains,esp32c3_matrix_fixture)
```

## app/boards/shields/esp32s3_matrix_fixture/Kconfig.shield
```kconfig
# Copyright (c) 2026 The ZMK Contributors
# SPDX-License-Identifier: MIT

config SHIELD_ESP32S3_MATRIX_FIXTURE
    def_bool $(shields_list_contains,esp32s3_matrix_fixture)
```

## app/module/drivers/display/Kconfig
```kconfig
# Copyright (c) 2021 The ZMK Contributors
# SPDX-License-Identifier: MIT

if DISPLAY

rsource "Kconfig.axs15231b"
rsource "Kconfig.il0323"

endif # DISPLAY
```

## app/module/drivers/display/Kconfig.axs15231b
```kconfig
# Copyright (c) 2026 The ZMK Contributors
# SPDX-License-Identifier: MIT

config AXS15231B
	bool "AXS15231B QSPI LCD display controller driver"
	depends on DT_HAS_AXS_AXS15231B_ENABLED
	select MSPI
	help
	  Enable driver for the AXS15231B QSPI LCD controller (e.g. the 3.5"
	  320x480 panel on the Guition JC3248W535 / cobantab1a module). The panel
	  is driven over QSPI: every frame is one bus transaction whose 32-bit
	  header (command phase + address phase, 1-wire) is followed by its
	  payload - parameters on one data line, pixels on the lines the node's
	  mspi-io-mode selects (1-1-1 or 1-1-4).

	  The node must sit on an MSPI controller ("espressif,esp32-mspi"): only
	  there are header and pixels a single transfer with per-phase line widths,
	  and the controller drives the CS line. SPI cannot frame this panel.

config AXS15231B_ROTATION_HW
	bool "Rotate the panel in hardware (MADCTL MV) instead of in software"
	default n
	depends on AXS15231B
	help
	  With a non-zero `rotation` on the panel node, turn the display with
	  MADCTL's MV/mirror bits and report the swapped resolution through the
	  display API, so LVGL renders the rotated UI natively and frames stream
	  through the driver unchanged (zero per-frame cost).

	  NOT YET PROVEN on this panel's QSPI row-pointer stream: the bench
	  findings that settled the write protocol were made at MADCTL 0x00.
	  Until a test pattern confirms the stream order under MV (see the note
	  in axs15231b.c), leave this off - the default software route transposes
	  each frame in the driver and is the proven path.
```

## app/module/drivers/input/Kconfig
```kconfig
if INPUT

rsource "Kconfig.axs15231b_touch"

config ZMK_INPUT_MOCK
    bool "Input Mock"
    default y
    depends on DT_HAS_ZMK_INPUT_MOCK_ENABLED

endif
```

## app/module/drivers/input/Kconfig.axs15231b_touch
```kconfig
# Copyright (c) 2026 The ZMK Contributors
# SPDX-License-Identifier: MIT

config AXS15231B_TOUCH
	bool "AXS15231B integrated touch controller driver"
	depends on AXS15231B
	depends on I2C
	select INPUT_TOUCH
	help
	  Enable driver for the capacitive touch controller integrated in the
	  AXS15231B LCD chip (e.g. the 3.5" 320x480 panel on the Guition
	  JC3248W535 / cobantab1a module). The controller shares the display
	  die but has its own I2C host interface (address 0x3B); no interrupt
	  or reset line is required, the driver polls it.
```

## app/module/dts/bindings/display/axs,axs15231b-common.yaml
```yaml
# Copyright (c) 2026 The ZMK Contributors
# SPDX-License-Identifier: MIT

title: AXS15231B QSPI LCD display controller, properties shared by both buses

# A fragment, not a binding: no 'compatible', so nothing is registered for it
# and it only contributes to the two bindings that include it.

# display-controller.yaml matters beyond width/height: as of Zephyr 4.5 it
# carries `class: display`, and the LVGL glue (zephyr/modules/lvgl/lvgl.c)
# refuses to build unless the node behind zephyr,display has that class.
include: [display-controller.yaml]

properties:
  cs-gpios:
    type: phandle-array
    required: false
    description: |
      Chip select, driven by this driver rather than by the bus core.

      The panel needs a 32-bit header on one data line and the pixels that
      follow a color header on four, all under one CS assertion, so the driver
      cannot let the bus core raise the line between the two phases. On the SPI
      path that means CS belongs to this driver: Zephyr's ESP32 SPI driver
      never reads SPI_HOLD_ON_CS, so a CS it owns would rise after the header
      and the panel would never start the memory write. Keep cs-gpios off the
      SPI bus node and put it here.

      On the MSPI path it is the other way round and this property is not read:
      the controller holds CE across a whole transaction, which is the reason
      to use that bus, and the line is listed in the controller node's
      ce-gpios instead.

  reset-gpios:
    type: phandle-array
    required: false
    description: |
      Optional RESET pin. Not wired on the JC3248W535 / cobantab1a, where the
      panel is reset by the SWRESET command instead. If present, the MCU pin
      should be configured active low.

  pwms:
    type: phandle-array
    required: false
    description: |
      Optional PWM spec for the backlight. The driver drives the duty from the
      blanking on/off handlers: fully on when unblanked, off when blanked.

  rotation:
    type: int
    required: false
    default: 0
    description: |
      Angle (0/90/180/270) the content is turned by, so a portrait-mounted
      panel can present a landscape UI. The same property is read by the app
      (app/src/display/main.c) to keep LVGL's logical resolution, the touch
      coordinate mapping, and the driver's pixel order on one side of the
      same angle. 90/270 swap the axes: a 320x480 node renders at 480x320.
```

## app/module/dts/bindings/display/axs,axs15231b-mspi.yaml
```yaml
# Copyright (c) 2026 The ZMK Contributors
# SPDX-License-Identifier: MIT

description: |
  AXS15231B QSPI LCD display controller, on an MSPI bus.

  Each frame is one transaction: the 32-bit header - a write opcode and an LCD
  command - goes out as the address phase on one data line, and the pixel data
  that follows a 0x32 header goes out as the data phase on four lines, with the
  controller holding chip select across both. That per-phase line width, under
  one CE assertion, is the reason to use this bus for this panel. The
  controller has to be in clock mode 3 (CPOL=1, CPHA=1).

  The controller drives CE, from its own ce-gpios indexed by this node's reg,
  so the node has no cs-gpios. The panel's clock is requested from
  mspi-max-frequency, and the pixel phase's line width from mspi-io-mode - of
  the values mspi-device.yaml allows, only MSPI_IO_MODE_SINGLE (1-1-1) and
  MSPI_IO_MODE_QUAD_1_1_4 can drive this panel, because the header is decoded
  from one line; the driver checks that at compile time.

  The same panel on an SPI controller is described by axs,axs15231b.yaml; both
  files use the same compatible, which devicetree allows because they ask for
  different buses.

compatible: "axs,axs15231b"

include: ["mspi-device.yaml", "axs,axs15231b-common.yaml"]
```

## app/module/dts/bindings/display/axs,axs15231b.yaml
```yaml
# Copyright (c) 2026 The ZMK Contributors
# SPDX-License-Identifier: MIT

description: |
  AXS15231B QSPI LCD display controller, on an SPI bus.

  Each frame starts with a 32-bit header - a write opcode and an LCD command -
  on one data line, and a 0x32 header is followed by its pixel data on all four
  lines, under a single chip select assertion. The controller has to be in
  clock mode 3 (CPOL=1, CPHA=1) and has to be able to put four data lines on
  the wire (CONFIG_SPI_EXTENDED_MODES); the QSPI lines plus SCLK have to be
  routed to the panel, on the ESP32 through the GPIO matrix.

  This panel can also sit on an MSPI controller; see axs,axs15231b-mspi.yaml.
  Both files use the same compatible, which devicetree allows because they ask
  for different buses: a node is matched against the binding for the bus its
  parent is a controller of, so exactly one of the two applies.

compatible: "axs,axs15231b"

include: [spi-device.yaml, "axs,axs15231b-common.yaml"]
```

## app/module/dts/bindings/input/axs,axs15231b-touch.yaml
```yaml
# Copyright (c) 2026 The ZMK Contributors
# SPDX-License-Identifier: MIT

description: |
  AXS15231B integrated capacitive touch controller.

  The touch controller is integrated in the AXS15231B LCD chip but has its
  own host interface, wired on the cobantab1a module to an I2C bus at
  address 0x3B. The node is a child of an I2C controller. No interrupt or
  reset line is required; the controller is polled.

compatible: "axs,axs15231b-touch"

include: [i2c-device.yaml, touchscreen-common.yaml]
```
