/*
 * Copyright (c) 2026 The ZMK Contributors
 *
 * SPDX-License-Identifier: MIT
 */

#include <zephyr/dt-bindings/pinctrl/esp-pinctrl-common.h>
#include <zephyr/dt-bindings/pinctrl/esp32s3-pinctrl.h>
#include <zephyr/dt-bindings/pinctrl/esp32s3-gpio-sigmap.h>

&pinctrl {
    /* Recovery console: GPIO43 (TX) / GPIO44 (RX). The display wiring
     * (SPI2 QSPI, I2C0 touch, PWM backlight) is routed by the cobantab1a
     * shield overlay in the ZMK config repo.
     */
    uart0_default: uart0_default {
        group1 {
            pinmux = <UART0_TX_GPIO43>;
            output-high;
        };

        group2 {
            pinmux = <UART0_RX_GPIO44>;
            bias-pull-up;
        };
    };
};
