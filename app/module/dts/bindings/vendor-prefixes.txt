## app/src/studio/Kconfig
```kconfig
# Copyright (c) 2024 The ZMK Contributors
# SPDX-License-Identifier: MIT

menuconfig ZMK_STUDIO
    bool "Studio Support"
    select ZMK_STUDIO_RPC if !ZMK_SPLIT || ZMK_SPLIT_ROLE_CENTRAL
    select PM_DEVICE # Needed for physical layout switching
    help
      Add firmware support for realtime keymap updates (ZMK Studio)

if ZMK_STUDIO

module = ZMK_STUDIO
module-str = zmk_studio
source "subsys/logging/Kconfig.template.log_config"

menuconfig ZMK_STUDIO_LOCKING
    bool "Lock Support"

if ZMK_STUDIO_LOCKING

config ZMK_STUDIO_LOCK_IDLE_TIMEOUT_SEC
    int "Idle Timeout"
    default 600

config ZMK_STUDIO_LOCK_ON_DISCONNECT
    bool "Lock On Disconnect"
    default y

endif

menuconfig ZMK_STUDIO_RPC
    bool "Remote Procedure Calls (RPC)"
    select NANOPB
    # These two save stack size
    imply NANOPB_NO_ERRMSG
    imply NANOPB_WITHOUT_64BIT
    imply NANOPB_NO_ENCODE_SIZE_CHECK
    imply ZMK_STUDIO_LOCKING if !ARCH_POSIX
    select CBPRINTF_LIBC_SUBSTS if ARCH_POSIX
    select SETTINGS
    select ZMK_BEHAVIOR_METADATA
    select ZMK_BEHAVIOR_LOCAL_IDS
    select RING_BUFFER
    select ZMK_KEYMAP_SETTINGS_STORAGE
    select ZMK_KEYMAP_LAYER_REORDERING
    help
      Add firmware support for studio RPC protocol

if ZMK_STUDIO_RPC

menu "Transports"

DT_CHOSEN_ZMK_STUDIO_RPC_UART := zmk,studio-rpc-uart

config ZMK_STUDIO_TRANSPORT_UART
    bool "Serial"
    select SERIAL
    select RING_BUFFER
    default y if $(dt_chosen_enabled,$(DT_CHOSEN_ZMK_STUDIO_RPC_UART))

if ZMK_STUDIO_TRANSPORT_UART

config ZMK_STUDIO_TRANSPORT_UART_RX_STACK_SIZE
    int "RX Stack Size"
    depends on !UART_INTERRUPT_DRIVEN
    default 512

config ZMK_STUDIO_TRANSPORT_UART_RX_PRIORITY
    int "RX Thread Priority"
    depends on !UART_INTERRUPT_DRIVEN
    default 9

config ZMK_STUDIO_RPC_TRANSPORT_UART_PREFERRED
    bool "Always select the UART transport"
    default n
    help
      Select the UART RPC transport regardless of the currently selected
      ZMK endpoint transport. Upstream keys the transport off the active
      endpoint (UART is the USB endpoint's transport), which display-first
      devices like the Coban Tab 1a never reach because they run BLE-only
      with ZMK USB off. Enable on such boards for the bench/Studio path;
      drop it once a real USB endpoint exists (b06 CDC-ACM on OTG).

endif

config ZMK_STUDIO_TRANSPORT_BLE
    bool "BLE (GATT)"
    select RING_BUFFER
    select BT_USER_DATA_LEN_UPDATE
    depends on ZMK_BLE
    default y

if ZMK_STUDIO_TRANSPORT_BLE

config ZMK_STUDIO_TRANSPORT_BLE_PREF_LATENCY
    int "BLE Transport preferred latency"
    default 10
    help
      When the studio UI is connected, a lower latency can be requested in order
      to make the interactions between keyboard and studio faster.

endif

endmenu

config ZMK_STUDIO_RPC_THREAD_STACK_SIZE
    int "RPC Thread Stack Size"
    default 4096

config ZMK_STUDIO_RPC_RX_BUF_SIZE
    int "RX Buffer Size"
    default 30

config ZMK_STUDIO_RPC_TX_BUF_SIZE
    int "TX Buffer Size"
    default 64

config ZMK_STUDIO_TOUCHPAD
    bool "Touchpad Studio Support"
    depends on ZMK_TOUCHPAD
    default y
    help
      Studio RPC support for touchpad configuration.

config ZMK_STUDIO_SETTINGS
    bool "Device Settings Studio Support"
    default y
    help
      Studio RPC support for reading and writing device settings, including
      Bluetooth profiles, sleep configuration, endpoint selection, and
      read-only diagnostics.

# Coban tab1a subsystems (backlog a14): the pad10a companion-app command
# set ported onto the Studio bus. Each maps onto an existing seam
# (screen mgr a08, time a09, stats a11, pomodoro a10, theme a07, assets
# a12) and follows the touchpad/settings gating pattern above.

config ZMK_STUDIO_SCREEN
    bool "Screen / time-sync Studio Support"
    depends on ZMK_DISPLAY_SCREEN_MGR
    default y
    help
      Studio RPC support for listing/navigating the tab's screens and
      host time sync (pad10a 0x51/0x52 parity).

config ZMK_STUDIO_THEME
    bool "Theme Studio Support"
    depends on ZMK_DISPLAY
    default y
    help
      Studio RPC support for reading and live-editing the display theme
      (pad10a 0x64 parity).

config ZMK_STUDIO_STATS
    bool "Stats Studio Support"
    depends on ZMK_STATS
    default y
    help
      Studio RPC support for the stats config and host stats data push
      (pad10a 0x53/0x54 parity).

config ZMK_STUDIO_POMO
    bool "Pomodoro Studio Support"
    depends on ZMK_POMODORO
    default y
    help
      Studio RPC support for pomodoro config, session control and state
      events (pad10a 0x59 parity).

config ZMK_STUDIO_ASSETS
    bool "Assets Studio Support"
    depends on ZMK_ASSETS
    default y
    help
      Studio RPC support for the asset manifest (list/activate; upload
      is a15, delete answered as unsupported until then).

config ZMK_STUDIO_ASSET_UPLOAD
    bool "Asset bulk upload (chunked + CRC)"
    depends on ZMK_STUDIO_ASSETS
    default y
    help
      a15: chunked host upload of asset blobs over the Studio RPC
      assets subsystem (begin/data/end/abort/status + GC), staging on a
      dedicated workqueue, CRC-verified manifest generations, and a
      real delete_asset. Only meaningful with a writable assets
      partition (Coban Tab 1a).

endif

endif
```

## app/src/tab1a/Kconfig
```kconfig
# Tab 1a bring-up modules (workspace backlog h01/c02)

config ZMK_TAB1A_HARNESS
	bool "Tab 1a dev harness probes"
	default n
	help
	  Bench bring-up probes for the tab1a dev harness overlay
	  (zmk/esp-port/bringup/tab1a-devkit.overlay): WS2812 chase, key
	  event logging, I2S test tone and a VBAT ADC read. Each probe is
	  additionally gated on the corresponding devicetree node, so
	  enabling this without the overlay is harmless. Not for product
	  builds.

config ZMK_TAB1A_DEBUG
	bool "Tab 1a boot-time storage/flash debug dump"
	default n
	select SETTINGS
	help
	  For the c02 qualification work: forces CONFIG_SETTINGS on even
	  with BLE disabled (it is normally only implied by ZMK_BLE), then
	  at boot dumps the storage flash area and runs a settings
	  write/read round-trip, so the `flash_esp32` error-261 failure is
	  reproducible independent of Bluetooth. Logs everything; not for
	  product builds.
```
