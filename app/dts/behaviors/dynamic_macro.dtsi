/*
 * Copyright (c) 2024 The ZMK Contributors
 *
 * SPDX-License-Identifier: MIT
 */

/ {
    behaviors {
        dm: dynamic_macro {
            compatible = "zmk,behavior-dynamic-macro";
            #binding-cells = <1>;
        };
    };
};
