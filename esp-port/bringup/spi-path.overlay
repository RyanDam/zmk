/*
 * Bring-up overlay: put the panel back on the SPI controller.
 *
 * The shield's own overlay re-types &spi2 as an MSPI controller, which is the
 * path every run in the findings doc since 2026-11-19 used (§9, §14). Row 26 says
 * that path is deaf in both framings, while the older SPI path is the one run
 * this project records as making the panel visibly respond (DISPLAY_OFF blanked
 * it - row 21's precedent). So the same instrument on this path is the cheapest
 * experiment that separates "the ported MSPI controller does not produce a usable
 * waveform" from "the panel or its wiring is dead" - and if the bars paint here,
 * the product is unblocked and MSPI becomes an optimisation.
 *
 * Applied after the shield's overlay (EXTRA_DTC_OVERLAY_FILE), so it wins: the
 * MSPI-only properties are deleted rather than left behind, because leaving
 * `ce-gpios` on the bus node would make two things drive CS at once.
 *
 * Build (from the repo root):
 *   sh esp-port/build_cobantab1a.sh \
 *        -C esp-port/bringup/spi-path.conf -O esp-port/bringup/spi-path.overlay
 */

#include <zephyr/dt-bindings/gpio/gpio.h>

&spi2 {
	compatible = "espressif,esp32-spi";

	/delete-property/ peripheral-id;
	/delete-property/ duplex;
	/delete-property/ ce-gpios;
	/delete-property/ dma-enabled;
	/delete-property/ dmas;
	/delete-property/ dma-names;

	/*
	 * Device-level half duplex, as the reference driver configures it
	 * (SPI_DEVICE_HALFDUPLEX). Zephyr's ESP32 driver rejects the per-transfer
	 * SPI_HALF_DUPLEX flag but applies this one through spi_hal_setup_device.
	 */
	half-duplex;

	axs15231b: axs15231b@0 {
		/delete-property/ mspi-max-frequency;
		/delete-property/ mspi-io-mode;
		/delete-property/ mspi-cpp-mode;

		/*
		 * CS on GPIO45, driven by the panel driver, not by the SPI core: the
		 * color header and its pixels need one CS assertion and Zephyr's ESP32
		 * SPI driver ignores SPI_HOLD_ON_CS. Leaving cs-gpios off &spi2 also
		 * keeps that driver's mode-3 phantom transfer out of the way.
		 */
		cs-gpios = <&gpio1 13 (GPIO_PULL_UP | GPIO_ACTIVE_LOW)>;

		/* 1 MHz, as in every bring-up run: at this rate clock and data skew
		 * cannot be the reason nothing arrives. */
		spi-max-frequency = <1000000>;
		spi-cpol;
		spi-cpha;
	};
};
